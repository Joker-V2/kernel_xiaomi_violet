## drivers/kernelsu/Kconfig
```kconfig
menu "KernelSU"

config KSU
	tristate "KernelSU function support"
	default y
	depends on OVERLAY_FS
	help
	  Enable kernel-level root privileges on Android System.
	  To compile as a module, choose M here: the
	  module will be called kernelsu.

config KSU_DEBUG
	bool "KernelSU debug mode"
	depends on KSU
	default n
	help
	  Enable KernelSU debug mode.

config KSU_ALLOWLIST_WORKAROUND
	bool "KernelSU allowlist workaround"
	depends on KSU
	default n
	help
	  Enable workaround for broken allowlist save.

choice
	prompt "KernelSU hook mode"
	default KSU_MANUAL_HOOK
	help
	  Select how KernelSU hooks into kernel.

config KSU_MANUAL_HOOK
	bool "KernelSU manual hook mode"
	depends on KSU && KSU != m
	help
	  Enable manual hook support.
	  Recommended for non-GKI kernels (e.g. 4.14).

config KSU_SYSCALL_HOOK
	bool "KernelSU syscall hook mode"
	depends on KSU
	depends on KPROBES && KRETPROBES && HAVE_SYSCALL_TRACEPOINTS
	help
	  Enable kprobes/kretprobes/tracepoint hooks.
	  NOT recommended for kernels below 5.10.

config KSU_NONE_HOOK
	bool "KernelSU none hook mode (SUSFS only)"
	depends on KSU && KSU != m && KSU_SUSFS
	help
	  Disable KernelSU core hooks and rely on SUSFS only.

endchoice

config KSU_MANUAL_SU
	bool "Use manual su"
	depends on KSU
	default y
	help
	  Use manual su and authorize via prctl.

config KPM
	bool "Enable SukiSU KPM"
	depends on KSU && 64BIT
	select KALLSYMS
	select KALLSYMS_ALL
	default n
	help
	  Enable SukiSU Kernel Protection Mode.
	  May affect stability on some devices.

menu "KernelSU - SUSFS"

config KSU_SUSFS
	bool "KernelSU addon - SUSFS"
	depends on KSU
	depends on THREAD_INFO_IN_TASK
	default n
	help
	  Patch and enable SUSFS support.

config KSU_SUSFS_SUS_PATH
	bool "Hide suspicious paths"
	depends on KSU_SUSFS
	default y
	help
	  Hide user-defined paths from system calls.

config KSU_SUSFS_SUS_MOUNT
	bool "Hide suspicious mounts"
	depends on KSU_SUSFS
	default y
	help
	  Hide mounts from /proc mount interfaces.

config KSU_SUSFS_SUS_KSTAT
	bool "Spoof suspicious kstat"
	depends on KSU_SUSFS
	default y
	help
	  Spoof kstat for hidden files.

config KSU_SUSFS_SPOOF_UNAME
	bool "Spoof uname"
	depends on KSU_SUSFS
	default y
	help
	  Spoof uname syscall output.

config KSU_SUSFS_ENABLE_LOG
	bool "Enable SUSFS logging"
	depends on KSU_SUSFS
	default y
	help
	  Enable kernel logging for SUSFS.

config KSU_SUSFS_HIDE_KSU_SUSFS_SYMBOLS
	bool "Hide KernelSU & SUSFS symbols"
	depends on KSU_SUSFS
	default y
	help
	  Hide symbols from /proc/kallsyms.

config KSU_SUSFS_SPOOF_CMDLINE_OR_BOOTCONFIG
	bool "Spoof cmdline/bootconfig"
	depends on KSU_SUSFS
	default y
	help
	  Spoof /proc/cmdline (non-GKI) or /proc/bootconfig (GKI).

config KSU_SUSFS_OPEN_REDIRECT
	bool "Enable open redirect"
	depends on KSU_SUSFS
	default y
	help
	  Redirect file open paths (experimental).

config KSU_SUSFS_SUS_MAP
	bool "Hide mapped files"
	depends on KSU_SUSFS
	default y
	help
	  Hide mapped files from proc maps interfaces.

endmenu

endmenu
```
